## configs/redpitaya12_defconfig
```kconfig
#
# Target options
#
BR2_arm=y

#
# armv7a cores
#
BR2_cortex_a9=y

#
# armv8.4a cores
#
BR2_ARM_ENABLE_NEON=y
BR2_ARM_ENABLE_VFP=y

#
# Kernel Header Options
#
BR2_PACKAGE_HOST_LINUX_HEADERS_CUSTOM_6_18=y

#
# GCC Options
#
BR2_TOOLCHAIN_BUILDROOT_CXX=y
BR2_TOOLCHAIN_BUILDROOT_WCHAR=y
BR2_CCACHE=y

#
# System configuration
#
BR2_TARGET_GENERIC_HOSTNAME="redpitaya12"
BR2_TARGET_GENERIC_ISSUE="Welcome to Red Pitaya12"
BR2_ROOTFS_DEVICE_CREATION_DYNAMIC_MDEV=y
BR2_TARGET_GENERIC_ROOT_PASSWD="root"
BR2_TARGET_GENERIC_GETTY_PORT="ttyPS0"

#
# Global configuration
#
BR2_GLOBAL_PATCH_DIR="$(BR2_EXTERNAL_REDPITAYA_PATH)/board/redpitaya/patches"
BR2_ROOTFS_OVERLAY="$(BR2_EXTERNAL_REDPITAYA_PATH)/board/redpitaya/overlay"
BR2_ROOTFS_POST_BUILD_SCRIPT="$(BR2_EXTERNAL_REDPITAYA_PATH)/board/redpitaya/post-build.sh"
BR2_ROOTFS_POST_IMAGE_SCRIPT="$(BR2_EXTERNAL_REDPITAYA_PATH)/board/redpitaya/post-image.sh"
BR2_ROOTFS_POST_SCRIPT_ARGS="-c $(BR2_EXTERNAL_REDPITAYA_PATH)/board/redpitaya/genimage-template.cfg"

#
# Kernel
#
BR2_LINUX_KERNEL=y
BR2_LINUX_KERNEL_CUSTOM_TARBALL=y
BR2_LINUX_KERNEL_CUSTOM_TARBALL_LOCATION="$(call github,Xilinx,linux-xlnx,xlnx_rebase_v6.18_LTS_2026.1)/xlnx_rebase_v6.18_LTS_2026.1.tar.gz"
BR2_LINUX_KERNEL_DEFCONFIG="xilinx_zynq"
BR2_LINUX_KERNEL_CONFIG_FRAGMENT_FILES="$(BR2_EXTERNAL_REDPITAYA_PATH)/board/redpitaya/linux-$(BR2_LINUX_KERNEL_VERSION)_fragment"
BR2_LINUX_KERNEL_DTS_SUPPORT=y
BR2_LINUX_KERNEL_INTREE_DTS_NAME="xilinx/zynq-red_pitaya12"
BR2_LINUX_KERNEL_DTB_OVERLAY_SUPPORT=y
BR2_LINUX_KERNEL_NEEDS_HOST_OPENSSL=y

#
# Filesystem images
#
BR2_TARGET_ROOTFS_EXT2=y
BR2_TARGET_ROOTFS_EXT2_4=y
BR2_TARGET_ROOTFS_EXT2_LABEL=""
BR2_TARGET_ROOTFS_EXT2_SIZE="120M"
# BR2_TARGET_ROOTFS_TAR is not set

#
# Bootloader
#
BR2_TARGET_UBOOT=y
BR2_TARGET_UBOOT_BUILD_SYSTEM_KCONFIG=y
BR2_TARGET_UBOOT_CUSTOM_TARBALL=y
BR2_TARGET_UBOOT_CUSTOM_TARBALL_LOCATION="$(call github,Xilinx,u-boot-xlnx,xlnx-rebase-v2026.01_2026.1)/xlnx-rebase-v2026.01_2026.1.tar.gz"
BR2_TARGET_UBOOT_BOARD_DEFCONFIG="xilinx_zynq_virt"
BR2_TARGET_UBOOT_CONFIG_FRAGMENT_FILES="$(BR2_EXTERNAL_REDPITAYA_PATH)/board/redpitaya/uboot.fragment"
BR2_TARGET_UBOOT_NEEDS_DTC=y
BR2_TARGET_UBOOT_NEEDS_OPENSSL=y
BR2_TARGET_UBOOT_NEEDS_GNUTLS=y
# BR2_TARGET_UBOOT_FORMAT_BIN is not set
BR2_TARGET_UBOOT_FORMAT_IMG=y
BR2_TARGET_UBOOT_SPL=y
BR2_TARGET_UBOOT_SPL_NAME="spl/boot.bin"
BR2_TARGET_UBOOT_CUSTOM_MAKEOPTS="DEVICE_TREE=zynq-red-pitaya12"

#
# Host utilities
#
BR2_PACKAGE_HOST_DOSFSTOOLS=y
BR2_PACKAGE_HOST_GENIMAGE=y
BR2_PACKAGE_HOST_MTOOLS=y

#
# Packages
#
BR2_PACKAGE_NFS_UTILS=y
BR2_PACKAGE_NFS_UTILS_RPC_LOCKD=y
BR2_PACKAGE_DBUS=y
BR2_PACKAGE_ZLIB=y
BR2_PACKAGE_NCURSES=y
BR2_PACKAGE_HAVEGED=y
BR2_PACKAGE_DROPBEAR=y
BR2_PACKAGE_IPTABLES=y
#BR2_PACKAGE_BUSYBOX=y
#BR2_PACKAGE_BUSYBOX_SHOW_OTHERS=y
#BR2_PACKAGE_I2C_TOOLS=y
```

## package/litex-etherbone-server/Config.in
```kconfig
config BR2_PACKAGE_LITEX_ETHERBONE_SERVER
	bool "LiteX EtherBone Server"
	help
	  Server between Zynq Memory and litex_server
```
